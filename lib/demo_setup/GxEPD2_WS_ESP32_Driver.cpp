
#define ENABLE_GxEPD2_GFX 0

#include "GxEPD2_WS_ESP32_Driver.hpp"

#include <GxEPD2_BW.h>
#include <GxEPD2_3C.h>
#include <DejaVuSansMono-Bold7pt8b.h>
#include <DejaVuSansMono-Bold24pt8b.h>
#include <DejaVuSans-Bold8pt8b.h>
#include <DejaVuSans-Bold10pt8b.h>
#include <DejaVuSans-Bold36pt8b.h>

#include <WeatherIconsR-Regular20pt8b.h>

#include <sunmoon.h>

// #include "bitmaps/Bitmaps3c128x296.h" // 2.9"  b/w/r

// 'swrt', 64x64px
const unsigned char myBitmap [] PROGMEM = {
	0xff, 0xff, 0xff, 0xff, 0xff, 0xff, 0xff, 0xff, 0xff, 0xff, 0xff, 0xff, 0xff, 0xff, 0xff, 0xff, 
	0xff, 0xff, 0xff, 0xff, 0xff, 0xff, 0xff, 0xff, 0xff, 0xff, 0xff, 0xff, 0xff, 0xff, 0xff, 0xff, 
	0xff, 0xff, 0xff, 0xff, 0xff, 0xff, 0xff, 0xff, 0xff, 0xff, 0xff, 0xff, 0xff, 0xff, 0xff, 0xff, 
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	0xff, 0xff, 0xff, 0xff, 0xff, 0xff, 0xff, 0xff, 0xff, 0xff, 0xff, 0xff, 0xff, 0xff, 0xff, 0xff
};



GxEPD2_3C<GxEPD2_750c, GxEPD2_750c::HEIGHT> display(GxEPD2_750c(/*CS=*/ 15, /*DC=*/ 27, /*RST=*/ 26, /*BUSY=*/ 25));

#define CX 20
#define CY 16
#define CWIDTH 144

char *cAbDays[] = { "Mo", "Di", "Mi", "Do", "Fr", "Sa", "So" };
char *cFlDays[] = { "Sonntag", "Montag", "Dienstag", "Mittwoch", "Donnerstag", "Freitag", "Samstag" };
char *cFlMonth[] = { "Januar", "Februar", "M�rz", "April", "Mai", "Juni", "Juli", "August", "September", "Oktober", "November", "Dezember" };
int daysOfMonth[] = { 31, 28, 31, 30, 31, 30, 31, 31, 30, 31, 30, 31 };

struct bitmap_pair
{
  const unsigned char* black;
  const unsigned char* red;
};

void drawBitmaps3c128x296()
{
   display.drawInvertedBitmap( 200, 100, myBitmap, 64, 64, GxEPD_BLACK );
   display.drawInvertedBitmap( 210, 110, myBitmap, 64, 64, GxEPD_RED );
}

void showCentered( int x, int y, int cwidth, char *text )
{
  int16_t x1, y1;
  uint16_t w, h;

  display.getTextBounds( text, 
    (uint16_t)x, (uint16_t)y, &x1, &y1, &w, &h );
  display.setCursor((x - 1) + ((cwidth-w) / 2), y );
  display.print( text );
}

void showClock( struct tm timeinfo, int x, int y )
{
  display.setFont(&DejaVuSans_Bold8pt8b);
  display.setCursor( x, y );
  display.print("Aktualisierung");
  display.setFont(&DejaVuSansMono_Bold24pt8b);
  display.setCursor( x, y+45 );
  display.printf("%02d:%02d", timeinfo.tm_hour, timeinfo.tm_min);
}

void showCalendar( time_t now, struct tm timeinfo, int x, int y )
{
  char buffer[32];
  int day = timeinfo.tm_mday;
  char *dayName = cFlDays[timeinfo.tm_wday];
  char *monthName = cFlMonth[timeinfo.tm_mon];

  int noDays = daysOfMonth[timeinfo.tm_mon];
  int year = timeinfo.tm_year + 1900;

  if ( timeinfo.tm_mon == 1 && timeinfo.tm_year % 4 == 0 )
  {
    noDays = 29;
  }

  time_t firstDayOfMonth = now - (( timeinfo.tm_mday - 1 ) * 86400 );   
  localtime_r( &firstDayOfMonth, &timeinfo);
 
  int firstDay = ( timeinfo.tm_wday + 6 ) % 7;

  y += 22;
  display.setTextColor(GxEPD_BLACK);
  display.setFont(&DejaVuSans_Bold10pt8b);
  showCentered( x, y, CWIDTH, dayName );

  y += 68;
  display.setFont(&DejaVuSans_Bold36pt8b);
  sprintf( buffer, "%02d", day );
  showCentered( x, y, CWIDTH, buffer );

  y += 32;
  display.setFont(&DejaVuSans_Bold10pt8b);
  showCentered( x, y, CWIDTH, monthName );

  y += 32;
  sprintf( buffer, "%02d", year );
  showCentered( x, y, CWIDTH, buffer );

  y += 32;
  display.setFont(&DejaVuSansMono_Bold7pt8b);
  for( int i=0; i<7; i++ )
  {
    display.setCursor( x + (i*CX), y );
    display.print( cAbDays[i] );
  }

  y += 4;
  display.drawLine( 0, y, CWIDTH, y, GxEPD_BLACK );

  y += CY-1;
  for( int i=0; i<noDays; i++ )
  {
    display.setCursor( x + ((((i+firstDay) % 7) * CX)), y + ((((i+firstDay) / 7) * CY)));

    if ( i+1 == day )
    {
      display.setTextColor(GxEPD_RED);
      display.printf( "%02d", (i+1));
      display.setTextColor(GxEPD_BLACK);
    }
    else
    {
      display.printf( "%02d", (i+1));
    }
  }
}

String getTimeString( time_t time )
{
  struct tm timeinfo;
  char buffer[6];
  localtime_r( &time, &timeinfo );
  sprintf( buffer, "%02d:%02d", timeinfo.tm_hour, timeinfo.tm_min );
  return String( buffer );
}

int zoneShift( int utc_hour, int zone )
{
  return ( utc_hour + zone ) % 24;
}

void demo_loop()
{
  static int lastMinute = -1; 
  struct tm timeinfo;
  time_t now = time(0);
  // now += 4 * 86400;
  localtime_r( &now, &timeinfo );


  if ( lastMinute == -1 || ( timeinfo.tm_min % 5 == 0 && lastMinute != timeinfo.tm_min ))
  {
    Serial.print( "\n time = ");
    Serial.println( getTimeString(1575838661));

    struct SUN_MOON sunmoon;
    int zone = 1;
    sun_moon( 52.0362, 10.4937, &timeinfo, 0, 0, &sunmoon );

    Serial.printf( "\n\nmoon phase number = %d%%\n", (int)round(sunmoon.MoonPhaseNumber*100) );
    Serial.printf( "moon phase = %d\n", sunmoon.MoonPhase );
    Serial.printf( "moon rise = %02d:%02d\n", zoneShift(sunmoon.MoonRise.hh, zone), sunmoon.MoonRise.mm );
    Serial.printf( "moon set = %02d:%02d\n", zoneShift(sunmoon.MoonSet.hh, zone), sunmoon.MoonSet.mm );
    Serial.printf( "sun rise = %02d:%02d\n", zoneShift(sunmoon.SunRise.hh, zone), sunmoon.SunRise.mm );
    Serial.printf( "sun set = %02d:%02d\n", zoneShift(sunmoon.SunSet.hh, zone), sunmoon.SunSet.mm );

    display.setFullWindow();
    display.setRotation(0);
    display.setTextColor(GxEPD_BLACK);
    display.firstPage();
    do
    {
      /* showCalendar( now, timeinfo, 2, 0 );
      showClock( timeinfo, 2, 315 );
      for ( int d = 0; d<4; d++ )
      {
        int x = 144 + 124 * d;
        display.drawLine( x, 0, x, 383, GxEPD_BLACK );
      }

      drawBitmaps3c128x296();
      */

      display.setTextColor(GxEPD_BLACK);
      display.setCursor( 0, 64 );
      display.setFont(&WeatherIconsR_Regular20pt8b);

  int16_t x1, y1;
  uint16_t w, h;

  display.getTextBounds( "!", 
    0, 64, &x1, &y1, &w, &h );

      Serial.printf( "x1=%d, y1=%d, w=%d, h=%d\n", x1, y1, w, h );

      for( uint8_t i = 0x21; i < 0xe9; i++ )
      {
        display.write( i );
      }

      /*
      display.write( (uint8_t)0x21 );
      display.write( (uint8_t)0x30 );
      display.write( (uint8_t)0x40 );
      display.write( (uint8_t)0x50 );
      display.write( (uint8_t)0x60 );
      display.write( (uint8_t)0x70 );
      display.write( (uint8_t)0x80 );

      display.write( (uint8_t)0x81 );
      display.write( (uint8_t)0x82 );
      display.write( (uint8_t)0x83 );
      display.write( (uint8_t)0x84 );
      display.write( (uint8_t)0x85 );
      display.write( (uint8_t)0x86 );
      display.write( (uint8_t)0x87 );

      display.write( (uint8_t)0x90 );
      display.write( (uint8_t)0xa0 );
      display.write( (uint8_t)0xb0 );
      display.write( (uint8_t)0xc0 );
      display.write( (uint8_t)0xd0 );
      display.write( (uint8_t)0xe0 );
      display.write( (uint8_t)0xf0 );
      */
    }
    while (display.nextPage());
    lastMinute = timeinfo.tm_min;
  }
}

void demo_setup()
{
  Serial.println();
  Serial.println("demo setup");

  display.init(); 
  SPI.end(); 
  SPI.begin(13, 12, 14, 15);  
  
  Serial.printf( "has partial update = %s\n", ( display.epd2.hasPartialUpdate) ? "true" : "false" );
  Serial.printf( "has fast partial update = %s\n", ( display.epd2.hasFastPartialUpdate) ? "true" : "false" );
  Serial.println("demo setup done");
}
